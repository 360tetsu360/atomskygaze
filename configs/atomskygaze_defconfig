## configs/atomskygaze_defconfig
```kconfig
BR2_mipsel=y
BR2_mips_32r2=y
# BR2_MIPS_SOFT_FLOAT is not set
BR2_MIPS_FP32_MODE_32=y
BR2_TOOLCHAIN_BUILDROOT_VENDOR="ingenic"
BR2_KERNEL_HEADERS_VERSION=y
BR2_DEFAULT_KERNEL_VERSION="3.10.98"
BR2_PACKAGE_HOST_LINUX_HEADERS_CUSTOM_3_10=y
BR2_PACKAGE_GLIBC_KERNEL_COMPAT=y
BR2_TOOLCHAIN_BUILDROOT_CXX=y
BR2_SHARED_STATIC_LIBS=y
BR2_TARGET_GENERIC_HOSTNAME="atomskygaze"
BR2_TARGET_GENERIC_ISSUE="Welcome to ATOM-SKYGAZE"
BR2_ROOTFS_DEVICE_CREATION_DYNAMIC_MDEV=y
BR2_TARGET_GENERIC_ROOT_PASSWD="atomskygaze"
BR2_ROOTFS_OVERLAY="../overlay_rootfs"
BR2_ROOTFS_POST_BUILD_SCRIPT=""
BR2_ROOTFS_POST_FAKEROOT_SCRIPT="../buildscripts/post_fakeroot.sh"
BR2_ROOTFS_POST_IMAGE_SCRIPT="../buildscripts/post_image.sh"
BR2_LINUX_KERNEL=y
BR2_LINUX_KERNEL_CUSTOM_TARBALL=y
BR2_LINUX_KERNEL_CUSTOM_TARBALL_LOCATION="https://s3-us-west-2.amazonaws.com/download.wyzecam.com/firmware/gpl/Linux_kernel_3.10_Wyze_Cam_v3.tar.gz"
BR2_LINUX_KERNEL_PATCH="../patches/kernel"
BR2_LINUX_KERNEL_USE_CUSTOM_CONFIG=y
BR2_LINUX_KERNEL_CUSTOM_CONFIG_FILE="../configs/kernel.config"
BR2_LINUX_KERNEL_IMAGE_TARGET_CUSTOM=y
BR2_LINUX_KERNEL_LZMA=y
BR2_LINUX_KERNEL_IMAGE_TARGET_NAME="uImage"
BR2_LINUX_KERNEL_IMAGE_NAME="uImage.lzma"
BR2_PACKAGE_BUSYBOX_INIT=y
BR2_PACKAGE_BUSYBOX_INIT_CONFIG="/src/configs/busybox-init.config"
BR2_PACKAGE_BUSYBOX_INIT_SHOW_OTHERS=y
BR2_PACKAGE_DOSFSTOOLS_INIT=y
BR2_PACKAGE_E2FSPROGS=y
BR2_PACKAGE_OPENCV4=y
BR2_PACKAGE_OPENCV4_LIB_CALIB3D=y
BR2_PACKAGE_OPENCV4_LIB_VIDEOIO=y
BR2_PACKAGE_OPENCV4_WITH_JPEG=y
BR2_PACKAGE_OPENCV4_CONTRIB=y
BR2_PACKAGE_OPENCV4_CONTRIB_LIB_BGSEGM=y
BR2_PACKAGE_OPENCV4_CONTRIB_LIB_XIMGPROC=y
BR2_PACKAGE_GSL=y
BR2_PACKAGE_ATBM_WIFI=y
BR2_PACKAGE_AVAHI=y
BR2_PACKAGE_AVAHI_DAEMON=y
BR2_PACKAGE_DNSMASQ=y
BR2_PACKAGE_HOSTAPD=y
BR2_PACKAGE_HOSTAPD_EAP=y
BR2_PACKAGE_NTP=y
BR2_PACKAGE_OPENSSH=y
BR2_PACKAGE_WPA_SUPPLICANT=y
BR2_PACKAGE_WPA_SUPPLICANT_CLI=y
BR2_PACKAGE_HTOP=y
BR2_TARGET_ROOTFS_SQUASHFS=y
# BR2_TARGET_ROOTFS_TAR is not set
```
